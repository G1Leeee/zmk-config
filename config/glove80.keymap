/*
 * Copyright (c) 2020 The ZMK Contributors
 * Copyright (c) 2023 Innaworks Development Limited, trading as MoErgo
 *
 * SPDX-License-Identifier: MIT
 */
/* THIS FILE WAS GENERATED BY GLOVE80 LAYOUT EDITOR
 *
 * This file was generated automatically. You may or may not want to
 * edit it directly.
 */
/* Include all behavior includes needed */

#include <behaviors.dtsi>
#include <dt-bindings/zmk/bt.h>
#include <dt-bindings/zmk/keys.h>
#include <dt-bindings/zmk/outputs.h>
#include <dt-bindings/zmk/rgb.h>

/* Automatically generated layer name #define */

#define LAYER_ColemakDH 0
#define LAYER_QWERTY 1
#define LAYER_Cursor 2
#define LAYER_Number 3
#define LAYER_Symbol 4
#define LAYER_Lower 5
#define LAYER_Magic 6
#define LAYER_System 7

/* To deal with the situation where there is no Lower layer, to keep &lower happy */

#ifndef LAYER_Lower

#define LAYER_Lower 0

#

endif {
    /* Custom Device-tree */
    /* Glove80 system behavior & macros */

    /

    behaviors {
        // For the "layer" key, it'd nice to be able to use it as either a shift or a toggle.
        // Configure it as a tap dance, so the first tap (or hold) is a &mo and the second tap is a &to

        lower: lower {
            compatible = "zmk,behavior-tap-dance";
            label = "LAYER_TAP_DANCE";
            #binding-cells = <0>;
            tapping-term-ms = <200>;
            bindings = <&mo LAYER_Lower>, <&to LAYER_Lower>;
        };
    };
};

/ {
    macros {
        rgb_ug_status_macro: rgb_ug_status_macro {
            label = "RGB_UG_STATUS";
            compatible = "zmk,behavior-macro";
            #binding-cells = <0>;
            bindings = <&rgb_ug RGB_STATUS>;
        };
    };
};

/ {
    #ifdef BT_DISC_CMD

    behaviors {
        bt_0: bt_0 {
            compatible = "zmk,behavior-tap-dance";
            label = "BT_0";
            #binding-cells = <0>;
            tapping-term-ms = <200>;
            bindings = <&bt_select_0>, <&bt BT_DISC 0>;
        };

        bt_1: bt_1 {
            compatible = "zmk,behavior-tap-dance";
            label = "BT_1";
            #binding-cells = <0>;
            tapping-term-ms = <200>;
            bindings = <&bt_select_1>, <&bt BT_DISC 1>;
        };

        bt_2: bt_2 {
            compatible = "zmk,behavior-tap-dance";
            label = "BT_2";
            #binding-cells = <0>;
            tapping-term-ms = <200>;
            bindings = <&bt_select_2>, <&bt BT_DISC 2>;
        };

        bt_3: bt_3 {
            compatible = "zmk,behavior-tap-dance";
            label = "BT_3";
            #binding-cells = <0>;
            tapping-term-ms = <200>;
            bindings = <&bt_select_3>, <&bt BT_DISC 3>;
        };
    };

    macros {
        bt_select_0: bt_select_0 {
            label = "BT_SELECT_0";
            compatible = "zmk,behavior-macro";
            #binding-cells = <0>;
            bindings = <&out OUT_BLE &bt BT_SEL 0>;
        };

        bt_select_1: bt_select_1 {
            label = "BT_SELECT_1";
            compatible = "zmk,behavior-macro";
            #binding-cells = <0>;
            bindings = <&out OUT_BLE &bt BT_SEL 1>;
        };

        bt_select_2: bt_select_2 {
            label = "BT_SELECT_2";
            compatible = "zmk,behavior-macro";
            #binding-cells = <0>;
            bindings = <&out OUT_BLE &bt BT_SEL 2>;
        };

        bt_select_3: bt_select_3 {
            label = "BT_SELECT_3";
            compatible = "zmk,behavior-macro";
            #binding-cells = <0>;
            bindings = <&out OUT_BLE &bt BT_SEL 3>;
        };
    };

    #else

    macros {
    };

    #endif
};

/ {
    behaviors {
        magic: magic {
            compatible = "zmk,behavior-hold-tap";
            label = "MAGIC_HOLD_TAP";
            #binding-cells = <2>;
            flavor = "tap-preferred";
            tapping-term-ms = <200>;
            bindings = <&mo>, <&rgb_ug_status_macro>;
        };
    };
};

/* #define for key positions */

#define POS_LH_T1 52
#define POS_LH_T2 53
#define POS_LH_T3 54
#define POS_LH_T4 69
#define POS_LH_T5 70
#define POS_LH_T6 71
#define POS_LH_C1R2 15
#define POS_LH_C1R3 27
#define POS_LH_C1R4 39
#define POS_LH_C1R5 51
#define POS_LH_C2R1 4
#define POS_LH_C2R2 14
#define POS_LH_C2R3 26
#define POS_LH_C2R4 38
#define POS_LH_C2R5 50
#define POS_LH_C2R6 68
#define POS_LH_C3R1 3
#define POS_LH_C3R2 13
#define POS_LH_C3R3 25
#define POS_LH_C3R4 37
#define POS_LH_C3R5 49
#define POS_LH_C3R6 67
#define POS_LH_C4R1 2
#define POS_LH_C4R2 12
#define POS_LH_C4R3 24
#define POS_LH_C4R4 36
#define POS_LH_C4R5 48
#define POS_LH_C4R6 66
#define POS_LH_C5R1 1
#define POS_LH_C5R2 11
#define POS_LH_C5R3 23
#define POS_LH_C5R4 35
#define POS_LH_C5R5 47
#define POS_LH_C5R6 65
#define POS_LH_C6R1 0
#define POS_LH_C6R2 10
#define POS_LH_C6R3 22
#define POS_LH_C6R4 34
#define POS_LH_C6R5 46
#define POS_LH_C6R6 64
#define POS_RH_T1 57
#define POS_RH_T2 56
#define POS_RH_T3 55
#define POS_RH_T4 74
#define POS_RH_T5 73
#define POS_RH_T6 72
#define POS_RH_C1R2 16
#define POS_RH_C1R3 28
#define POS_RH_C1R4 40
#define POS_RH_C1R5 58
#define POS_RH_C2R1 5
#define POS_RH_C2R2 17
#define POS_RH_C2R3 29
#define POS_RH_C2R4 41
#define POS_RH_C2R5 59
#define POS_RH_C2R6 75
#define POS_RH_C3R1 6
#define POS_RH_C3R2 18
#define POS_RH_C3R3 30
#define POS_RH_C3R4 42
#define POS_RH_C3R5 60
#define POS_RH_C3R6 76
#define POS_RH_C4R1 7
#define POS_RH_C4R2 19
#define POS_RH_C4R3 31
#define POS_RH_C4R4 43
#define POS_RH_C4R5 61
#define POS_RH_C4R6 77
#define POS_RH_C5R1 8
#define POS_RH_C5R2 20
#define POS_RH_C5R3 32
#define POS_RH_C5R4 44
#define POS_RH_C5R5 62
#define POS_RH_C5R6 78
#define POS_RH_C6R1 9
#define POS_RH_C6R2 21
#define POS_RH_C6R3 33
#define POS_RH_C6R4 45
#define POS_RH_C6R5 63
#define POS_RH_C6R6 79

/* Custom Defined Behaviors */

/ {
    behaviors {
        #ifndef HOMEY_HOLDING_TYPE
    #define HOMEY_HOLDING_TYPE "tap-preferred"
    #endif

    #ifndef HOMEY_HOLDING_TIME
    #define HOMEY_HOLDING_TIME 270 // TAPPING_TERM + ALLOW_CROSSOVER_AFTER
    #endif

    #ifndef HOMEY_STREAK_DECAY
    #define HOMEY_STREAK_DECAY 170 // global-quick-tap-ms
    #endif

    #ifndef HOMEY_REPEAT_DECAY
    #define HOMEY_REPEAT_DECAY 300 // "tap then hold" for key auto-repeat
    #endif

    #ifndef SHIFT_HOLDING_TYPE
    #define SHIFT_HOLDING_TYPE "tap-preferred"
    #endif

    #ifndef SHIFT_HOLDING_TIME
    #define SHIFT_HOLDING_TIME 185
    #endif

    #ifndef SHIFT_STREAK_DECAY
    #define SHIFT_STREAK_DECAY 70 // global-quick-tap-ms
    #endif

    #ifndef SHIFT_REPEAT_DECAY
    #define SHIFT_REPEAT_DECAY 300 // "tap then hold" for key auto-repeat
    #endif

    #ifndef THUMB_HOLDING_TYPE
    #define THUMB_HOLDING_TYPE "balanced"
    #endif

    #ifndef THUMB_HOLDING_TIME
    #define THUMB_HOLDING_TIME 200
    #endif

    #ifndef THUMB_REPEAT_DECAY
    #define THUMB_REPEAT_DECAY 300 // "tap then hold" for key auto-repeat
    #endif

    #ifndef SPACE_HOLDING_TIME
    #define SPACE_HOLDING_TIME 170
    #endif

    #ifndef SPACE_REPEAT_DECAY
    #define SPACE_REPEAT_DECAY 200 // "tap then hold" for key auto-repeat
    #endif

    // |------------------------|------------------------|
    // | LEFT_HAND_KEYS         |        RIGHT_HAND_KEYS |
    // |                        |                        |
    // |  0  1  2  3  4         |          5  6  7  8  9 |
    // | 10 11 12 13 14 15      |      16 17 18 19 20 21 |
    // | 22 23 24 25 26 27      |      28 29 30 31 32 33 |
    // | 34 35 36 37 38 39      |      40 41 42 43 44 45 |
    // | 46 47 48 49 50 51      |      58 59 60 61 62 63 |
    // | 64 65 66 67 68         |         75 76 77 78 79 |
    // |                69 52   |   57 74                |
    // |                 70 53  |  56 73                 |
    // |                  71 54 | 55 72                  |
    // |------------------------|------------------------|
    //
    #define LEFT_HAND_KEYS      \
          0  1  2  3  4         \
         10 11 12 13 14 15      \
         22 23 24 25 26 27      \
         34 35 36 37 38 39      \
         46 47 48 49 50 51      \
         64 65 66 67 68
    #define RIGHT_HAND_KEYS     \
                                           5  6  7  8  9 \
                                       16 17 18 19 20 21 \
                                       28 29 30 31 32 33 \
                                       40 41 42 43 44 45 \
                                       58 59 60 61 62 63 \
                                          75 76 77 78 79
    #define THUMB_KEYS          \
                        69 52       57 74                \
                         70 53     56 73                 \
                          71 54   55 72

        homey_left: miryoku_home_row_mods_left_hand {
            compatible = "zmk,behavior-hold-tap";
            label = "HOME_ROW_MODS_LEFT_HAND";
            flavor =
            HOMEY_HOLDING_TYPE;
            hold-trigger-key-positions = <RIGHT_HAND_KEYS THUMB_KEYS>;
            hold-trigger-on-release; // wait for other home row mods
            tapping-term-ms = <HOMEY_HOLDING_TIME>;
            quick-tap-ms = <HOMEY_REPEAT_DECAY>;
            require-prior-idle-ms = <HOMEY_STREAK_DECAY>;
            #binding-cells = <2>;
            bindings = <&kp>, <&kp>;
        };

        homey_right: miryoku_home_row_mods_right_hand {
            compatible = "zmk,behavior-hold-tap";
            label = "HOME_ROW_MODS_RIGHT_HAND";
            flavor =
            HOMEY_HOLDING_TYPE;
            hold-trigger-key-positions = <LEFT_HAND_KEYS THUMB_KEYS>;
            hold-trigger-on-release; // wait for other home row mods
            tapping-term-ms = <HOMEY_HOLDING_TIME>;
            quick-tap-ms = <HOMEY_REPEAT_DECAY>;
            require-prior-idle-ms = <HOMEY_STREAK_DECAY>;
            #binding-cells = <2>;
            bindings = <&kp>, <&kp>;
        };

        shift_left: miryoku_home_row_mods_left_shift_shift {
            compatible = "zmk,behavior-hold-tap";
            label = "HOME_ROW_MODS_LEFT_SHIFT_SHIFT";
            flavor =
            SHIFT_HOLDING_TYPE;
            hold-trigger-key-positions = <RIGHT_HAND_KEYS THUMB_KEYS>;

            //hold-trigger-on-release; // don't wait for other mods

            tapping-term-ms = <SHIFT_HOLDING_TIME>;
            quick-tap-ms = <SHIFT_REPEAT_DECAY>;
            require-prior-idle-ms = <SHIFT_STREAK_DECAY>;
            #binding-cells = <2>;
            bindings = <&kp>, <&kp>;
        };

        shift_right: miryoku_home_row_mods_right_shift_shift {
            compatible = "zmk,behavior-hold-tap";
            label = "HOME_ROW_MODS_RIGHT_SHIFT_SHIFT";
            flavor =
            SHIFT_HOLDING_TYPE;
            hold-trigger-key-positions = <LEFT_HAND_KEYS THUMB_KEYS>;

            //hold-trigger-on-release; // don't wait for other mods

            tapping-term-ms = <SHIFT_HOLDING_TIME>;
            quick-tap-ms = <SHIFT_REPEAT_DECAY>;
            require-prior-idle-ms = <SHIFT_STREAK_DECAY>;
            #binding-cells = <2>;
            bindings = <&kp>, <&kp>;
        };

        thumb: miryoku_thumb_layer {
            compatible = "zmk,behavior-hold-tap";
            label = "MIRYOKU_THUMB_LAYER";
            flavor =
            THUMB_HOLDING_TYPE;
            tapping-term-ms = <THUMB_HOLDING_TIME>;
            quick-tap-ms = <THUMB_REPEAT_DECAY>; // enable repeat
            //global-quick-tap; // no typing streak
            //retro-tap; // don't allow slow (hold-like) taps

            #binding-cells = <2>;
            bindings = <&mo>, <&kp>;
        };

        space: miryoku_thumb_layer_spacebar {
            compatible = "zmk,behavior-hold-tap";
            label = "MIRYOKU_THUMB_LAYER_SPACEBAR";
            flavor =
            THUMB_HOLDING_TYPE;
            tapping-term-ms = <SPACE_HOLDING_TIME>;
            quick-tap-ms = <SPACE_REPEAT_DECAY>; // enable repeat
            //global-quick-tap; // no typing streak

            retro-tap; // allow slow (hold-like) taps
            #binding-cells = <2>;
            bindings = <&mo>, <&kp>;
        };

        cappy: capsword_and_capslock {
            compatible = "zmk,behavior-mod-morph";
            label = "CAPSWORD_AND_CAPSLOCK";
            #binding-cells = <0>;
            bindings = <&caps_word>, <&kp CAPSLOCK>;

            mods = <(MOD_LSFT|MOD_RSFT)>;
        };

        sst: sst {
            compatible = "zmk,behavior-tap-dance";
            label = "SST";
            #binding-cells = <0>;
            bindings = <&kp T>, <&kp LS(T)>;

            tapping-term-ms = <150>;
        };
    };
};

/* Automatically generated macro definitions */

/ {
    macros {
    };
};

/* Automatically generated combos definitions */

/ {
    combos {
        compatible = "zmk,combos";

        combo_question {
            key-positions = <62 61>;
            bindings = <&kp QMARK>;
            layers = <0 1>;
        };

        combo_colon {
            key-positions = <32 31>;
            bindings = <&kp COLON>;
            layers = <0 1>;
        };

        combo_d_quote {
            key-positions = <44 45>;
            bindings = <&kp DQT>;
            layers = <0 1>;
        };

        combo_exclamation {
            key-positions = <61 60>;
            bindings = <&kp EXCL>;
            layers = <0 1>;
        };

        combo_ssang_ae1 {
            key-positions = <43 44>;
            bindings = <&kp LS(P)>;
            layers = <1>;
        };

        combo_ssang_ae2 {
            key-positions = <30 31>;
            bindings = <&kp LS(O)>;
            layers = <1>;
        };

        combo_pipe {
            key-positions = <62 63>;
            bindings = <&kp PIPE>;
            layers = <0 1>;
        };
    };
};

/* Automatically generated keymap */

/ {
    keymap {
        compatible = "zmk,keymap";

        layer_ColemakDH {
            bindings = <
&kp F1                &kp F2                &kp F3                  &kp F4                   &kp F5                                                                                                                                                                &kp F6               &kp F7                    &kp F8                 &kp F9                    &kp F10
&to 2                 &none                 &none                   &none                    &none               &none                                                                                                                              &kp LC(LG(V))  &kp RALT             &to 1                     &kp LA(E)              &kp LA(P)                 &kp PSCRN
&kp DEL               &kp Q                 &homey_left LG(LEFT) W  &homey_left LG(RIGHT) F  &kp P               &kp B                                                                                                                              &kp J          &kp L                &kp U                     &kp Y                  &kp SEMI                  &kp LA(TAB)
&mt LA(F4) ESC        &kp A                 &homey_left LGUI R      &homey_left LCTRL S      &homey_left LALT T  &kp G                                                                                                                              &kp M          &homey_right LALT N  &homey_right LCTRL E      &homey_right LGUI I    &kp O                     &kp SQT
&cappy                &shift_left LSHIFT Z  &homey_left LC(S) X     &homey_left LA(S) C      &kp D               &kp V  &kp C_PP                       &kp C_VOL_DN               &kp C_VOL_UP    &kp C_MUTE  &kp C_PREV               &kp C_NEXT   &kp K          &kp H                &homey_right RCTRL COMMA  &homey_right RALT DOT  &shift_right RSHIFT FSLH  &kp BSLH
&magic LAYER_Magic 0  &kp LEFT              &kp UP                  &kp DOWN                 &kp RIGHT                  &thumb LAYER_Cursor BACKSPACE  &thumb LAYER_Number ENTER  &lt 5 RALT      &tog 1      &thumb LAYER_Symbol TAB  &lt 5 SPACE                 &kp LA(SPACE)        &kp C_BRI_UP              &kp C_BRI_DN           &kp F11                   &kp F12
            >;
        };

        layer_QWERTY {
            bindings = <
&trans  &trans                &trans                  &trans                   &trans                                                                                       &trans               &trans                &trans               &trans    &trans
&trans  &kp LS(Q)             &kp LS(W)               &kp LS(E)                &kp LS(R)           &kp LS(T)                                                        &trans  &to 0                &kp RALT              &trans               &trans    &trans
&trans  &kp Q                 &homey_left LG(LEFT) W  &homey_left LG(RIGHT) E  &kp R               &sst                                                             &kp Y   &kp U                &kp I                 &kp O                &kp SEMI  &trans
&trans  &kp A                 &homey_left LGUI S      &homey_left LCTRL D      &homey_left LALT F  &kp G                                                            &kp H   &homey_right LALT J  &homey_right LCTRL K  &homey_right LGUI L  &kp P     &trans
&trans  &shift_left LSHIFT Z  &homey_left LC(S) X     &homey_left LA(S) C      &kp V               &kp B      &trans  &trans  &trans    &trans      &trans  &trans  &kp N   &kp M                &trans                &trans               &trans    &trans
&trans  &trans                &trans                  &trans                   &trans                         &trans  &trans  &to 0     &lt 5 RALT  &trans  &trans          &trans               &trans                &trans               &trans    &trans
            >;
        };

        layer_Cursor {
            bindings = <
&none     &none             &none       &none                   &none                                                                                  &none   &none    &none    &none    &none
&to 0     &none             &none       &none                   &none              &none                                                    &none      &to 0   &to 1    &none    &none    &none
&to 1     &kp LC(Z)         &kp PG_UP   &kp PG_DN               &kp LG(TAB)        &kp LC(Y)                                                &kp LC(I)  &kp F9  &kp F10  &kp F11  &kp F12  &none
&kp HOME  &kp LEFT          &kp UP      &homey_left LCTRL DOWN  &kp RIGHT          &kp END                                                  &kp LC(B)  &kp F5  &kp F6   &kp F7   &kp F8   &none
&none     &kp LC(LS(LEFT))  &kp LS(UP)  &kp LS(DOWN)            &kp LC(LS(RIGHT))  &kp INS    &none   &none   &none    &none  &none  &none  &kp LC(U)  &kp F1  &kp F2   &kp F3   &kp F4   &none
&trans    &trans            &trans      &trans                  &trans                        &trans  &trans  &to 0    &to 1  &none  &none             &trans  &trans   &trans   &none    &none
            >;
        };

        layer_Number {
            bindings = <
&none      &none            &none          &none      &none                                                                                      &none   &none   &none   &none            &none
&none      &none            &none          &none      &none          &none                                                         &none         &none   &none   &none   &none            &none
&none      &kp LC(LS(G))    &kp LC(F)      &kp LG(E)  &kp LC(G)      &none                                                         &kp UNDER     &kp N7  &kp N8  &kp N9  &kp CARET        &none
&kp LC(L)  &kp LC(LS(TAB))  &kp LC(LS(T))  &kp LC(W)  &kp LC(TAB)    &kp LG(V)                                                     &kp MINUS     &kp N4  &kp N5  &kp N6  &kp KP_PLUS      &kp KP_NUM
&none      &kp LC(X)        &kp LC(C)      &kp LC(V)  &kp LC(GRAVE)  &kp LC(K)  &none   &none   &none    &none  &none      &none   &kp KP_SLASH  &kp N1  &kp N2  &kp N3  &kp KP_MULTIPLY  &kp KP_EQUAL
&none      &none            &none          &none      &none                     &trans  &trans  &to 0    &none  &kp EQUAL  &kp N0                &trans  &trans  &trans  &trans           &none
            >;
        };

        layer_Symbol {
            bindings = <
&none             &none      &none      &none     &none                                                                                               &none     &none             &none              &none        &none
&none             &none      &none      &none     &none     &none                                                                              &none  &none     &none             &none              &none        &none
&kp LC(KP_MINUS)  &kp LBKT   &kp LPAR   &kp RPAR  &kp RBKT  &kp LC(LA(KP_MINUS))                                                               &none  &none     &kp LC(LG(LEFT))  &kp LC(LG(RIGHT))  &none        &none
&kp GRAVE         &kp EXCL   &kp AT     &kp HASH  &kp DLLR  &kp LG(DOT)                                                                        &none  &kp LGUI  &kp LCTRL         &caps_word         &kp LA(TAB)  &none
&kp TILDE         &kp PRCNT  &kp CARET  &kp AMPS  &kp STAR  &none                 &none   &none   &trans    &none              &none   &none   &none  &none     &none             &none              &none        &none
&none             &trans     &trans     &trans    &trans                          &trans  &trans  &to 0     &tog LAYER_Symbol  &trans  &trans         &trans    &trans            &trans             &trans       &none
            >;
        };

        layer_Lower {
            bindings = <
&kp C_BRI_DN          &kp C_BRI_UP  &kp C_PREV  &kp C_NEXT   &kp C_PP                                                                                                    &kp C_MUTE  &kp C_VOL_DN  &kp C_VOL_UP      &none              &none
&none                 &none         &none       &none        &none      &none                                                                                     &none  &none       &none         &none             &none              &none
&to 0                 &to 1         &to 2       &to 3        &to 4      &none                                                                                     &none  &kp PIPE    &kp UNDER     &kp LC(LG(LEFT))  &kp LC(LG(RIGHT))  &none
&none                 &kp LA(F4)    &kp ESC     &kp LG(TAB)  &kp LG(E)  &none                                                                                     &none  &kp BSLH    &kp MINUS     &caps_word        &kp LA(TAB)        &none
&none                 &none         &none       &none        &none      &none  &trans             &trans             &trans    &trans  &trans             &trans  &none  &none       &none         &none             &none              &none
&magic LAYER_Magic 0  &none         &none       &none        &none             &tog LAYER_Cursor  &tog LAYER_Number  &none     &none   &tog LAYER_Symbol  &trans         &none       &none         &none             &none              &trans
            >;
        };

        layer_Magic {
            bindings = <
&bt BT_CLR   &none            &none            &none            &none                                                                                       &none  &none  &none  &none  &bt BT_CLR_ALL
&to 0        &to 2            &to 3            &to 4            &to 7            &none                                                               &none  &none  &none  &none  &none  &none
&none        &rgb_ug RGB_SPI  &rgb_ug RGB_SAI  &rgb_ug RGB_HUI  &rgb_ug RGB_BRI  &rgb_ug RGB_TOG                                                     &none  &none  &none  &none  &none  &none
&bootloader  &rgb_ug RGB_SPD  &rgb_ug RGB_SAD  &rgb_ug RGB_HUD  &rgb_ug RGB_BRD  &rgb_ug RGB_EFF                                                     &none  &none  &none  &none  &none  &bootloader
&sys_reset   &none            &none            &none            &none            &none            &bt_2  &bt_3  &none           &none  &none  &none  &none  &none  &none  &none  &none  &sys_reset
&none        &none            &none            &none            &none                             &bt_0  &bt_1  &out OUT_USB    &none  &none  &none         &none  &none  &none  &none  &none
            >;
        };

        layer_System {
            bindings = <
&none            &none            &none            &none            &none                                                                                                       &none     &none      &none     &none      &none
&none            &none            &none            &none            &none            &none                                                                               &none  &none     &none      &none     &none      &none
&none            &none            &rgb_ug RGB_HUD  &rgb_ug RGB_HUI  &none            &none                                                                               &none  &none     &none      &none     &none      &none
&rgb_ug RGB_TOG  &rgb_ug RGB_EFR  &rgb_ug RGB_BRD  &rgb_ug RGB_BRI  &rgb_ug RGB_EFF  &none                                                                               &none  &kp LGUI  &kp LSHFT  &kp LALT  &kp LCTRL  &none
&none            &rgb_ug RGB_SPD  &rgb_ug RGB_SAD  &rgb_ug RGB_SAI  &rgb_ug RGB_SPI  &none  &kp K_LOCK  &kp C_SLEEP  &kp C_PWR          &none              &none  &none  &none  &none     &none      &none     &none      &none
&none            &none            &none            &none            &none                   &kp PSCRN   &kp SLCK     &kp PAUSE_BREAK    &tog LAYER_System  &none  &none         &none     &none      &none     &none      &none
            >;
        };
    };
};
